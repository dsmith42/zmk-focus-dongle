## dts/bindings/behaviors/zmk,behavior-focus-start.yaml
```yaml
# SPDX-License-Identifier: MIT

description: |
  Start a focus block of the armed length.

  Ignored while a block is live, including while it is overrunning — an
  overrunning block holds its figure until it is deliberately stopped.

compatible: "zmk,behavior-focus-start"

include: zero_param.yaml
```

## dts/bindings/behaviors/zmk,behavior-focus-stop.yaml
```yaml
# SPDX-License-Identifier: MIT

description: |
  Stop the running focus block and clear it.

  Also the act that ends an overrunning block, which is the moment its overrun
  is read.

compatible: "zmk,behavior-focus-stop"

include: zero_param.yaml
```

## dts/bindings/behaviors/zmk,behavior-focus-theme-next.yaml
```yaml
# SPDX-License-Identifier: MIT

description: |
  Step to the next palette, wrapping.

  Walks the theme nodes devicetree declared, in order, rather than counting to a
  fixed number — so a palette you added at index 9 is reachable by cycling, and
  a gap in the numbering cannot land on a colour nobody declared.

  Like selecting a palette by index, this works while a block is running: the
  colour is metadata and changing it destroys no elapsed time.

compatible: "zmk,behavior-focus-theme-next"

include: zero_param.yaml
```

## dts/bindings/behaviors/zmk,behavior-focus-theme.yaml
```yaml
# SPDX-License-Identifier: MIT

description: |
  Select the dial's palette by index.

  The index is a theme node's `index` property, not its position in devicetree —
  so adding a palette of your own cannot renumber the ones a keymap already
  binds.

  Unlike arming and starting, this works WHILE A BLOCK IS RUNNING. Length and
  elapsed time are the data a stray keypress must not destroy; a colour destroys
  nothing, and changing your mind about what a block is halfway through is a
  real thing that happens.

  An index with no theme behind it draws the default palette rather than
  nothing: a wrong colour is a visible mistake, a black dial looks like a crash.

compatible: "zmk,behavior-focus-theme"

include: one_param.yaml
```

## dts/bindings/behaviors/zmk,behavior-focus-time.yaml
```yaml
# SPDX-License-Identifier: MIT

description: |
  Arm a focus block of the given length in minutes.

  Arming only selects; nothing runs until a focus-start binding is pressed. The
  armed length survives a block, so the common case is start-without-choosing.

  Ignored while a block is live, including while it is overrunning. Changing
  length mid-block is therefore stop, arm, start — three deliberate acts.

compatible: "zmk,behavior-focus-time"

include: one_param.yaml
```

## dts/bindings/behaviors/zmk,behavior-screen-brightness.yaml
```yaml
# SPDX-License-Identifier: MIT

description: |
  Step the display backlight.

  Declare one node per direction and give each its own step, rather than passing
  a direction as a parameter:

      screen_brighter: screen_brighter {
          compatible = "zmk,behavior-screen-brightness";
          step = <20>;
          #binding-cells = <0>;
      };

      screen_dimmer: screen_dimmer {
          compatible = "zmk,behavior-screen-brightness";
          step = <(-20)>;
          #binding-cells = <0>;
      };

  The value is clamped to 5..100 percent. Not down to zero: an unreadable screen
  looks identical to a broken one, and the way back would be a key you cannot
  see.

  Nothing is persisted — a power cycle returns to
  CONFIG_FOCUS_DONGLE_FIXED_BRIGHTNESS, like every other piece of state here.

compatible: "zmk,behavior-screen-brightness"

properties:
  step:
    type: int
    required: true
    description: Percent to change by. Negative dims.

include: zero_param.yaml
```

## reference-config/boards/shields/ref_peripheral/Kconfig.shield
```kconfig
config SHIELD_REF_PERIPHERAL
    def_bool $(shields_list_contains,ref_peripheral)
```
